#include <WiFi.h>
#include <HTTPClient.h>
#include "esp_timer.h"
#include "Arduino.h"

// ==========================================
// 1. NETWORK CONFIGURATION
// ==========================================
const char* ssid = "HUAWEI nova 3i";
const char* password = "senidu1234";

// Backend Server
String serverName = "192.168.43.243"; 
int serverPort = 5001;
String serverPath = "/detect";

// ==========================================
// 2. SERVO CONFIGURATION (GPIO 12 & 13)
// ==========================================
#define SERVO_PAN_PIN 12
#define SERVO_TILT_PIN 13

// PWM Properties
#define PWM_FREQ 50
#define PWM_RES 16
#define SERVO_MIN_US 500
#define SERVO_MAX_US 2400
#define SERVO_MIN_DUTY (int)((SERVO_MIN_US * 65536.0) / 20000.0)
#define SERVO_MAX_DUTY (int)((SERVO_MAX_US * 65536.0) / 20000.0)

#define SERVO_MAX_DUTY (int)((SERVO_MAX_US * 65536.0) / 20000.0)

// Channels (Not needed for v3)
// #define SERVO_PAN_CH 2
// #define SERVO_TILT_CH 3

// ==========================================
// 3. DUMMY IMAGE (Small 1x1 JPEG Header)
// ==========================================
// This is a minimal valid JPEG header to satisfy the backend's image check
const uint8_t dummy_jpg[] = {
  0xFF, 0xD8, 0xFF, 0xE0, 0x00, 0x10, 0x4A, 0x46, 0x49, 0x46, 0x00, 0x01, 0x01, 0x01, 0x00, 0x48,
  0x00, 0x48, 0x00, 0x00, 0xFF, 0xDB, 0x00, 0x43, 0x00, 0xFF, 0xFF, 0xFF, 0xFF, 0xFF, 0xFF, 0xFF,
  0xFF, 0xFF, 0xFF, 0xFF, 0xFF, 0xFF, 0xFF, 0xFF, 0xFF, 0xFF, 0xFF, 0xFF, 0xFF, 0xFF, 0xFF, 0xFF,
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  0xA0, 0x0F, 0xFF, 0xD9
};
const size_t dummy_len = sizeof(dummy_jpg);

unsigned long lastUploadTime = 0;
#define UPLOAD_INTERVAL 2000

void setServoAngle(int pin, int angle) {
  if (angle < 0) angle = 0;
  if (angle > 180) angle = 180;
  int duty = map(angle, 0, 180, SERVO_MIN_DUTY, SERVO_MAX_DUTY);
  ledcWrite(pin, duty);
}

void setup() {
  Serial.begin(115200);
  Serial.println();

  // Servo Init (v3 API)
  ledcAttach(SERVO_PAN_PIN, PWM_FREQ, PWM_RES);
  ledcAttach(SERVO_TILT_PIN, PWM_FREQ, PWM_RES);

  // Center Servos
  setServoAngle(SERVO_PAN_PIN, 90);
  setServoAngle(SERVO_TILT_PIN, 90);

  // WiFi
  WiFi.begin(ssid, password);
  while (WiFi.status() != WL_CONNECTED) {
    delay(500);
    Serial.print(".");
  }
  Serial.println("\nWiFi connected");
  Serial.print("ESP32 Simulator Ready! IP: ");
  Serial.println(WiFi.localIP());
}

void sendDummyImage() {
  HTTPClient http;
  String url = "http://" + serverName + ":" + String(serverPort) + serverPath;
  
  Serial.print("Sending Ping to: ");
  Serial.println(url);

  http.begin(url);

  String head = "--RandomBoundary\r\nContent-Disposition: form-data; name=\"image\"; filename=\"dummy.jpg\"\r\nContent-Type: image/jpeg\r\n\r\n";
  String tail = "\r\n--RandomBoundary--\r\n";

  uint32_t totalLen = dummy_len + head.length() + tail.length();

  http.addHeader("Content-Type", "multipart/form-data; boundary=RandomBoundary");
  http.addHeader("Content-Length", String(totalLen));

  uint8_t *buffer = (uint8_t *)malloc(totalLen);
  if (buffer) {
    memcpy(buffer, head.c_str(), head.length());
    memcpy(buffer + head.length(), dummy_jpg, dummy_len);
    memcpy(buffer + head.length() + dummy_len, tail.c_str(), tail.length());

    int httpResponseCode = http.POST(buffer, totalLen);
    
    if (httpResponseCode > 0) {
      String response = http.getString();
      Serial.println(httpResponseCode);
      Serial.println(response);

      // Parse Servo Command
      int cmdIdx = response.indexOf("servo_cmd");
      if (cmdIdx > 0) {
        int panIdx = response.indexOf("\"pan\":", cmdIdx);
        int tiltIdx = response.indexOf("\"tilt\":", cmdIdx);
        
        if (panIdx > 0 && tiltIdx > 0) {
          int panEnd = response.indexOf(",", panIdx);
          if (panEnd < 0) panEnd = response.indexOf("}", panIdx);
          String panStr = response.substring(panIdx + 6, panEnd);
          int panAngle = panStr.toInt();
          
          int tiltEnd = response.indexOf("}", tiltIdx);
          if (tiltEnd < 0) tiltEnd = response.indexOf(",", tiltIdx);
          String tiltStr = response.substring(tiltIdx + 7, tiltEnd);
          int tiltAngle = tiltStr.toInt();
          
          Serial.printf("Moving Servos -> Pan: %d, Tilt: %d\n", panAngle, tiltAngle);
          setServoAngle(SERVO_PAN_PIN, panAngle);
          setServoAngle(SERVO_TILT_PIN, tiltAngle);
        }
      }
    } else {
      Serial.print("Error on sending POST: ");
      Serial.println(httpResponseCode);
    }
    free(buffer);
  } else {
    Serial.println("Malloc failed!");
  }
  http.end();
}

void loop() {
  if (millis() - lastUploadTime > UPLOAD_INTERVAL) {
    sendDummyImage();
    lastUploadTime = millis();
  }
}
